;;--------------------------------------------------------------------------------
;; $Header: /home/amb/pic/common/RCS/pcd8544_char.inc,v 1.4 2010/09/19 09:54:51 amb Exp $
;;
;; Include file for PCD8544 based LCD character functions.
;;
;; Written by Andrew M. Bishop
;;
;; This file Copyright 2007, 2010 Andrew M. Bishop
;; It may be distributed under the GNU Public License, version 2, or
;; any higher version.  See section COPYING of the GNU Public license
;; for conditions under which this file may be redistributed.
;;
;;--------------------------------------------------------------------------------
;;
;; The font used is the 5x8 font from X11 which has the following copyright notice.
;;
;; Copyright 1984-1989, 1994 Adobe Systems Incorporated.
;; Copyright 1988, 1994 Digital Equipment Corporation.
;;
;;--------------------------------------------------------------------------------

;;--------------------------------------------------------------------------------
;;
;; Required Variables / Constants for PCD8544 based LCD character functions
;;
;; Variables:   spi_temp        - Stores temporary data, same bank as PCD8544_PORT
;;              pcd8544_temp    - Stores temporary data, same bank as PCD8544_PORT
;;              pcd8544_char_row - Stores the current row in character mode, same bank as PCD8544_PORT
;;              pcd8544_char_col - Stores the current column in character mode, same bank as PCD8544_PORT
;;
;;--------------------------------------------------------------------------------

;;
;; Rows and columns start from zero at the top left.
;;      Row can range from 0 to 5
;;      Column can range from 0 to 15
;;
;; Each character is 8x5 which means that there are 16x6 characters on the screen
;;
;; In pixel terms there are 2 blank pixels at each end (2+16*5+2 = 84).
;;

;;--------------------------------------------------------------------------------
;;
;; Subroutine to initialise character mode
;;
;; Parameters:  none
;;
;; RAM Bank:    any (in) PCD8544_PORT (out)
;;
;;--------------------------------------------------------------------------------

pcd8544_char_init

        ;; Reset X,Y counters

        call    pcd8544_reset_xy

        clrf    pcd8544_char_row
        clrf    pcd8544_char_col

        movlw   0
        call    pcd8544_tx_byte
        call    pcd8544_tx_byte

        return


;;--------------------------------------------------------------------------------
;;
;; Subroutine to change the row (column remains unchanged)
;; (Uses macros from pcd8544_basic.inc instead of subroutines for speed)
;;
;; Parameters:  W (in)                  - New row number
;;
;; RAM Bank:    any (in) PCD8544_PORT (out)
;;
;;--------------------------------------------------------------------------------

pcd8544_char_set_row
        BANKSEL PCD8544_PORT

        PCD8544_COMMAND_MODE    ; Enter command mode

        movwf   pcd8544_char_row

        movlw   0x07
        andwf   pcd8544_char_row,F

        ;; Y=W

        movlw   0x40
        iorwf   pcd8544_char_row,W
        call    pcd8544_tx_byte

        PCD8544_DATA_MODE       ; Enter data mode

        return


;;--------------------------------------------------------------------------------
;;
;; Subroutine to change the column (row remains unchanged)
;; (Uses macros from pcd8544_basic.inc instead of subroutines for speed)
;;
;; Parameters:  W (in)                  - New column number
;;
;; RAM Bank:    any (in) PCD8544_PORT (out)
;;
;;--------------------------------------------------------------------------------

pcd8544_char_set_column
        BANKSEL PCD8544_PORT

        PCD8544_COMMAND_MODE    ; Enter command mode

        movwf   pcd8544_char_col

        movwf   pcd8544_temp
        bsf     STATUS,C
        rlf     pcd8544_temp,F  ; Multiply by 2 and add 1
        bcf     STATUS,C
        rlf     pcd8544_temp,F  ; Multiply by 2
        addwf   pcd8544_temp,F

        ;; X=5*W+2

        bsf     pcd8544_temp,7
        movf    pcd8544_temp,W
        call    pcd8544_tx_byte

        PCD8544_DATA_MODE       ; Enter data mode

        return


;;--------------------------------------------------------------------------------
;;
;; Subroutine to increment the row and reset the column to zero
;; (Uses macros from pcd8544_basic.inc instead of subroutines for speed)
;;
;; Parameters:  none
;;
;; RAM Bank:    any (in) PCD8544_PORT (out)
;;
;;--------------------------------------------------------------------------------

pcd8544_char_newline
        BANKSEL PCD8544_PORT

        PCD8544_COMMAND_MODE    ; Enter command mode

        ;; Reset the column

        clrf    pcd8544_char_col

        ;; X=2

        movlw   0x80 + 0x02
        call    pcd8544_tx_byte

        ;; Increment the row

        incf    pcd8544_char_row,F
        movlw   6
        subwf   pcd8544_char_row,W
        btfsc   STATUS,Z
        clrf    pcd8544_char_row

        ;; Y=W

        movlw   0x40
        iorwf   pcd8544_char_row,W
        call    pcd8544_tx_byte

        PCD8544_DATA_MODE       ; Enter data mode

        return


;;--------------------------------------------------------------------------------
;;
;; Subroutine to print an ASCII character
;;
;; Parameters:  W (in)                  - Character to print
;;
;; RAM Bank:    any (in) PCD8544_PORT (out)
;;
;;--------------------------------------------------------------------------------

pcd8544_char_print
        BANKSEL PCD8544_PORT

        movwf   pcd8544_temp

        ; Force characters above 127 to be 127

        btfsc   pcd8544_temp,7
        goto    pcd8544_char_print_127

        ; Handle special characters below 32

        movlw   10
        subwf   pcd8544_temp,W
        btfsc   STATUS,Z
        goto    pcd8544_char_print_newline

        ; Force other characters below 32 to be 127

        movlw   32
        subwf   pcd8544_temp,F
        btfss   STATUS,C
        goto    pcd8544_char_print_127

        ; Print the 5 bytes for the character

pcd8544_char_print_do_print

        call    pcd8544_charmap_byte_1
        call    pcd8544_tx_byte

        call    pcd8544_charmap_byte_2
        call    pcd8544_tx_byte

        call    pcd8544_charmap_byte_3
        call    pcd8544_tx_byte

        call    pcd8544_charmap_byte_4
        call    pcd8544_tx_byte

        call    pcd8544_charmap_byte_5
        call    pcd8544_tx_byte

        ;; Increment the column counter

        incf    pcd8544_char_col,F
        btfsc   pcd8544_char_col,4
        goto    pcd8544_char_newline

        return

pcd8544_char_print_127
        movlw   95              ; already subtracted 32
        movwf   pcd8544_temp
        goto    pcd8544_char_print_do_print

pcd8544_char_print_newline
        movlw   16
        subwf   pcd8544_char_col,F
        movlw   0

pcd8544_char_print_newline_loop
        call    pcd8544_tx_byte
        call    pcd8544_tx_byte
        call    pcd8544_tx_byte
        call    pcd8544_tx_byte
        call    pcd8544_tx_byte

        incfsz  pcd8544_char_col,F
        goto    pcd8544_char_print_newline_loop

        goto    pcd8544_char_newline


;;--------------------------------------------------------------------------------

pcd8544_charmap_byte_1

        movf    pcd8544_temp,W
        movwf   spi_temp

        movlw   LOW ($+9)       ; low 8 bits of address
        addwf   spi_temp,F      ; 8 bit addition
 
        movlw   HIGH ($+7)      ; high 5 bits of address
        btfsc   STATUS,C        ; skip if no 8 bit add overflow
        addlw   1
        movwf   PCLATH          ; load high address in latch
 
        movf    spi_temp,W      ; Move modified value into W
        goto    $+1             ; Jump to cause update of PCL high bits
        movwf   PCL             ; set PCL low bits

        retlw   0x00            ; ' ' byte 1
        retlw   0x00            ; '!' byte 1
        retlw   0x00            ; '"' byte 1
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        retlw   0xFF            ; ERR byte 1

;;--------------------------------------------------------------------------------

pcd8544_charmap_byte_2

        movf    pcd8544_temp,W
        movwf   spi_temp

        movlw   LOW ($+9)       ; low 8 bits of address
        addwf   spi_temp,F      ; 8 bit addition
 
        movlw   HIGH ($+7)      ; high 5 bits of address
        btfsc   STATUS,C        ; skip if no 8 bit add overflow
        addlw   1
        movwf   PCLATH          ; load high address in latch
 
        movf    spi_temp,W      ; Move modified value into W
        goto    $+1             ; Jump to cause update of PCL high bits
        movwf   PCL             ; set PCL low bits

        retlw   0x00            ; ' ' byte 2
        retlw   0x00            ; '!' byte 2
        retlw   0x0E            ; '"' byte 2
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        retlw   0x81            ; ERR byte 2

;;--------------------------------------------------------------------------------

pcd8544_charmap_byte_3

        movf    pcd8544_temp,W
        movwf   spi_temp

        movlw   LOW ($+9)       ; low 8 bits of address
        addwf   spi_temp,F      ; 8 bit addition
 
        movlw   HIGH ($+7)      ; high 5 bits of address
        btfsc   STATUS,C        ; skip if no 8 bit add overflow
        addlw   1
        movwf   PCLATH          ; load high address in latch
 
        movf    spi_temp,W      ; Move modified value into W
        goto    $+1             ; Jump to cause update of PCL high bits
        movwf   PCL             ; set PCL low bits

        retlw   0x00            ; ' ' byte 3
        retlw   0x5E            ; '!' byte 3
        retlw   0x00            ; '"' byte 3
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        retlw   0x81            ; ERR byte 3

;;--------------------------------------------------------------------------------

pcd8544_charmap_byte_4

        movf    pcd8544_temp,W
        movwf   spi_temp

        movlw   LOW ($+9)       ; low 8 bits of address
        addwf   spi_temp,F      ; 8 bit addition
 
        movlw   HIGH ($+7)      ; high 5 bits of address
        btfsc   STATUS,C        ; skip if no 8 bit add overflow
        addlw   1
        movwf   PCLATH          ; load high address in latch
 
        movf    spi_temp,W      ; Move modified value into W
        goto    $+1             ; Jump to cause update of PCL high bits
        movwf   PCL             ; set PCL low bits

        retlw   0x00            ; ' ' byte 4
        retlw   0x00            ; '!' byte 4
        retlw   0x0E            ; '"' byte 4
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        retlw   0x81            ; ERR byte 4

;;--------------------------------------------------------------------------------

pcd8544_charmap_byte_5

        movf    pcd8544_temp,W
        movwf   spi_temp

        movlw   LOW ($+9)       ; low 8 bits of address
        addwf   spi_temp,F      ; 8 bit addition
 
        movlw   HIGH ($+7)      ; high 5 bits of address
        btfsc   STATUS,C        ; skip if no 8 bit add overflow
        addlw   1
        movwf   PCLATH          ; load high address in latch
 
        movf    spi_temp,W      ; Move modified value into W
        goto    $+1             ; Jump to cause update of PCL high bits
        movwf   PCL             ; set PCL low bits

        retlw   0x00            ; ' ' byte 5
        retlw   0x00            ; '!' byte 5
        retlw   0x00            ; '"' byte 5
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        retlw   0xFF            ; ERR byte 5

;;--------------------------------------------------------------------------------
